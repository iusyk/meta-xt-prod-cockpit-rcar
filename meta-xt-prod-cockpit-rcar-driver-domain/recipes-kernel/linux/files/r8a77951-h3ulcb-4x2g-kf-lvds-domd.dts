// SPDX-License-Identifier: GPL-2.0
/*
 * Device Tree Source for the H3ULCB Kingfisher board
 * running XEN hypervisor
 *
 * Copyright (C) 2016-2018 Renesas Electronics Corp.
 * Copyright (C) 2016 Cogent Embedded, Inc.
 */

#include "r8a77951-h3ulcb-4x2g-kf-domd.dtsi"

/ {
	rvgc {
		displays {
			display-0 {
				display-map = <0>;
			};
		};
	};
};
